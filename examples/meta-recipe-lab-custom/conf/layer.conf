## examples/meta-recipe-lab-custom/conf/layer.conf
```bitbake
BBPATH .= ":${LAYERDIR}"

BBFILES += "${LAYERDIR}/recipes-*/*/*.bb ${LAYERDIR}/recipes-*/*/*.bbappend"

BBFILE_COLLECTIONS += "recipe-lab-custom"
BBFILE_PATTERN_recipe-lab-custom = "^${LAYERDIR}/"
BBFILE_PRIORITY_recipe-lab-custom = "7"

LAYERDEPENDS_recipe-lab-custom = "core recipe-lab"
LAYERSERIES_COMPAT_recipe-lab-custom = "scarthgap"
```

## examples/meta-recipe-lab/conf/layer.conf
```bitbake
BBPATH .= ":${LAYERDIR}"

BBFILES += "${LAYERDIR}/recipes-*/*/*.bb ${LAYERDIR}/recipes-*/*/*.bbappend"

BBFILE_COLLECTIONS += "recipe-lab"
BBFILE_PATTERN_recipe-lab = "^${LAYERDIR}/"
BBFILE_PRIORITY_recipe-lab = "6"

LAYERDEPENDS_recipe-lab = "core"
LAYERSERIES_COMPAT_recipe-lab = "scarthgap"
```
